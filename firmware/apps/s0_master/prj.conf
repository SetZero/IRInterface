## CMakeLists.txt
```
# SPDX-License-Identifier: Apache-2.0

cmake_minimum_required(VERSION 3.20.0)

# Board definitions live in firmware/boards.
list(APPEND BOARD_ROOT ${CMAKE_CURRENT_LIST_DIR}/../..)

find_package(Zephyr REQUIRED HINTS $ENV{ZEPHYR_BASE})
project(s0_master LANGUAGES C CXX)

target_sources(app PRIVATE
  src/link/link.cpp
  src/main.cpp
  src/meter/hub.cpp
  src/meter/iec62056.cpp
  src/meter/sml.cpp
  src/network/captive_portal.cpp
  src/network/mqtt.cpp
  src/network/wifi.cpp
  src/system/config.cpp
  src/system/glue.c
  src/web/api.cpp
  src/web/web.cpp
)
# Sources include each other relative to src/, e.g. "meter/hub.hpp".
target_include_directories(app PRIVATE src ../../lib/irlink/include)

# Zephyr's Kconfig stops at C++23; the application itself is C++26.
target_compile_options(app PRIVATE $<$<COMPILE_LANGUAGE:CXX>:-std=c++26>)

# The HTTP server finds its resources in an iterable linker section that is
# named after the service declared in src/system/glue.c.
zephyr_linker_sources(SECTIONS sections-rom.ld)
zephyr_linker_section(NAME http_resource_desc_s0_http KVMA RAM_REGION GROUP RODATA_REGION)

# The dashboard is a single page, gzip-compressed into the firmware image.
generate_inc_file_for_target(app
  dashboard/index.html
  ${ZEPHYR_BINARY_DIR}/include/generated/index.html.gz.inc
  --gzip
)
```

## prj.conf
```kconfig
# C++ application (the standard is raised to C++26 in CMakeLists.txt)
CONFIG_CPP=y
CONFIG_STD_CPP23=y
CONFIG_REQUIRES_FULL_LIBCPP=y

CONFIG_MAIN_STACK_SIZE=5200
CONFIG_SYSTEM_WORKQUEUE_STACK_SIZE=4096
CONFIG_REBOOT=y
# why the device last restarted, for the status document
CONFIG_HWINFO=y

# Console on UART0: log output and the "s0" shell commands
CONFIG_LOG=y
CONFIG_SHELL=y
CONFIG_SHELL_STACK_SIZE=5200

# RS-485 link to the IR head
CONFIG_SERIAL=y
CONFIG_UART_INTERRUPT_DRIVEN=y

# Settings in the flash "storage" partition
CONFIG_FLASH=y
CONFIG_FLASH_MAP=y
CONFIG_NVS=y
CONFIG_SETTINGS=y
CONFIG_SETTINGS_NVS=y

# Wi-Fi: station plus setup access point
CONFIG_WIFI=y
CONFIG_WIFI_NM=y
CONFIG_WIFI_USAGE_MODE_STA_AP=y
CONFIG_ESP32_WIFI_STA_AUTO_DHCPV4=y
CONFIG_WIFI_LOG_LEVEL_ERR=y

# IP stack
CONFIG_NETWORKING=y
CONFIG_NET_IPV4=y
CONFIG_NET_IPV6=n
CONFIG_NET_TCP=y
CONFIG_NET_UDP=y
CONFIG_NET_SOCKETS=y
CONFIG_NET_L2_ETHERNET=y
CONFIG_NET_L2_WIFI_MGMT=y
CONFIG_NET_MGMT=y
CONFIG_NET_MGMT_EVENT=y
CONFIG_NET_MGMT_EVENT_INFO=y
CONFIG_NET_MGMT_EVENT_QUEUE_SIZE=16
CONFIG_NET_MGMT_EVENT_QUEUE_TIMEOUT=5000
CONFIG_NET_MGMT_EVENT_STACK_SIZE=4096
CONFIG_NET_CONFIG_AUTO_INIT=n
CONFIG_NET_DHCPV4=y
CONFIG_NET_DHCPV4_SERVER=y
# Captive portal: clients of the setup access point use this device as
# name server (network/captive_portal.cpp answers there).
CONFIG_NET_DHCPV4_SERVER_OPTION_DNS_ADDRESS="192.168.4.1"
CONFIG_NET_IF_MAX_IPV4_COUNT=2
CONFIG_NET_TX_STACK_SIZE=2048
CONFIG_NET_RX_STACK_SIZE=2048
CONFIG_NET_PKT_RX_COUNT=16
CONFIG_NET_PKT_TX_COUNT=16
CONFIG_NET_BUF_RX_COUNT=64
CONFIG_NET_BUF_TX_COUNT=64
CONFIG_NET_MAX_CONTEXTS=16
CONFIG_NET_MAX_CONN=16
CONFIG_NET_TCP_TIME_WAIT_DELAY=0
CONFIG_ENTROPY_GENERATOR=y

# Reachable as http://s0-master.local
CONFIG_NET_HOSTNAME_ENABLE=y
CONFIG_NET_HOSTNAME="s0-master"
CONFIG_MDNS_RESPONDER=y
CONFIG_DNS_RESOLVER=y

# Web server with WebSocket upgrade
CONFIG_HTTP_PARSER=y
CONFIG_HTTP_PARSER_URL=y
CONFIG_HTTP_SERVER=y
CONFIG_HTTP_SERVER_WEBSOCKET=y
# one per live-stream client; web/web.hpp checks this against its client slots
CONFIG_WEBSOCKET_MAX_CONTEXTS=4
CONFIG_HTTP_SERVER_MAX_CLIENTS=6
CONFIG_HTTP_SERVER_STACK_SIZE=6144
CONFIG_HTTP_SERVER_CLIENT_BUFFER_SIZE=1024
CONFIG_NET_SOCKETS_SERVICE_STACK_SIZE=4096
CONFIG_EVENTFD=y
CONFIG_ZVFS_EVENTFD_MAX=4
CONFIG_ZVFS_OPEN_MAX=32
CONFIG_ZVFS_POLL_MAX=16

# MQTT publisher
CONFIG_MQTT_LIB=y
CONFIG_MQTT_KEEPALIVE=60
```

## src/main.cpp
```c
/**
 * @file
 * @brief S0 master: reads an electricity meter through the IR head and serves
 *        the values over a web dashboard, REST, WebSocket and MQTT.
 *
 * SPDX-License-Identifier: Apache-2.0
 */

#include <zephyr/kernel.h>
#include <zephyr/logging/log.h>

#include "web/api.hpp"
#include "system/config.hpp"
#include "link/link.hpp"
#include "network/captive_portal.hpp"
#include "system/glue.h"
#include "network/mqtt.hpp"
#include "web/web.hpp"
#include "network/wifi.hpp"

LOG_MODULE_REGISTER(s0_main, LOG_LEVEL_INF);

int main()
{
	LOG_INF("S0 master %.*s", static_cast<int>(s0::firmware_version.size()),
		s0::firmware_version.data());

	LOG_INF("last restart: %s", s0_restart_reason());

	/* every failure below is logged where it happens and the device carries on */
	(void)s0::Settings::instance().load();

	s0::Link::instance().start();
	s0::Wifi::instance().start();
	s0::CaptivePortal::instance().start();
	s0::Mqtt::instance().start();
	(void)s0::WebServer::instance().start();

	return 0;
}
```
