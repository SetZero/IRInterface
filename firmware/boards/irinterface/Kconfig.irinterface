## firmware/boards/irinterface/Kconfig.irinterface
```kconfig
# SPDX-License-Identifier: Apache-2.0

config BOARD_IRINTERFACE
	select SOC_STM32G030XX
```

## firmware/boards/irinterface/board.yml
```yaml
board:
  name: irinterface
  full_name: IR Interface (optical meter head)
  socs:
    - name: stm32g030xx
```

## firmware/boards/s0_master/Kconfig
```kconfig
# SPDX-License-Identifier: Apache-2.0

config HEAP_MEM_POOL_ADD_SIZE_BOARD
	int
	default 4096 if BOARD_S0_MASTER_ESP32S3_PROCPU
	default 256 if BOARD_S0_MASTER_ESP32S3_APPCPU
```
