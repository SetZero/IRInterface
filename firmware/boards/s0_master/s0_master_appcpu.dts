/*
 * S0 Master 0.1 - second core image
 *
 * SPDX-License-Identifier: Apache-2.0
 */

/dts-v1/;

#include <espressif/esp32s3/esp32s3_wroom_n4r2.dtsi>
#include <espressif/partitions_0x0_amp_4M.dtsi>
#include "s0_master-pinctrl.dtsi"

/ {
	model = "S0 Master 0.1 APPCPU";
	compatible = "espressif,esp32s3";

	chosen {
		zephyr,sram = &sram1;
		zephyr,ipc_shm = &shm0;
		zephyr,ipc = &ipm0;
		zephyr,flash = &flash0;
		zephyr,code-partition = &slot0_appcpu_partition;
	};
};

&trng0 {
	status = "okay";
};

&ipm0 {
	status = "okay";
};
